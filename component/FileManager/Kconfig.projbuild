## component/FileManager/Kconfig.projbuild
```kconfig
menu "SD Card menu"

    config SD_PIN_NUM_MOSI
        int "MOSI GPIO Number"
        default 19
        help
            GPIO number for SPI master MOSI.

    config SD_PIN_NUM_MISO
        int "MISO GPIO Number"
        default 21
        help
            GPIO number for SPI master MISO.

    config SD_PIN_NUM_CLK
        int "CLK GPIO Number"
        default 18
        help
            GPIO number for SPI master CLK.

    config SD_PIN_NUM_CS
        int "CS GPIO Number"
        default 5
        help
            GPIO number for SPI master CS.
            
endmenu
```

## main/Kconfig.projbuild
```kconfig
menu "WIFI/SMART CONFIG Configuration"

    config DEFAULT_AP_SSID
        string "The default AP SSID of the device"
        default "WICOM"
        help
            The default SSID that the device will connect in case that it failed to connect AP of Smart config in the first Smart Config

    config DEFAULT_AP_PASSWORD
        string "The default AP PASSWORD of the device"
        default "Wicom123"
        help
            The default PASSWORD that the device will connect in case that it failed to connect AP of Smart config in the first Smart Config

     config DEFAULT_AP_MAC
        string "The default AP MAC address of the device"
        default "Wicom123"
        help
            The default MAC address that the device will connect in case that it failed to connect AP of Smart config in the first Smart Config

    config MAX_RECONNECT_ATTEMP_NUMBER
        int "The max reconnect attemp number"
        default 5
        help
            The number ESP32 will try to reconnect if it is disconnected from the local network.
endmenu

menu "HTTP Configuration"
    config HTTP_ENDPOINT
        string "HTTP Endpoint"
        default "httpbin.org"
        help
            Target endpoint host-name for the ESP32 to use.
endmenu
```
